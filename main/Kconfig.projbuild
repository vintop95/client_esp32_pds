## main/Kconfig.projbuild
```kconfig
menu "WiFi - Server Connection Configuration"

config DEVICE_NAME
    string "Device Name"
    help
	Name of the device.

config ESP_WIFI_SSID
    string "WiFi SSID"
    help
	SSID (network name) for the example to connect to.

config ESP_WIFI_PASSWORD
    string "WiFi Password"
    help
	WiFi password (WPA or WPA2) for the example to use.

config SERVER_IP
    string "Server IP Address"
    help
	IP address of the serverP.  
endmenu
```
